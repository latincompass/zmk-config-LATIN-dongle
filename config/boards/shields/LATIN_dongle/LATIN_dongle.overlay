#include <dt-bindings/zmk/matrix_transform.h>

/ {
	chosen {
		zmk,matrix_transform = &dummy_transform;
	};

	dummy_transform: keymap_transform_0 {
		compatible = "zmk,matrix-transform";
		columns = <1>;
		rows = <1>;
		map = <
			RC(0,0)
		>;
	};
};
