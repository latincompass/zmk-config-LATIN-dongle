## config/boards/shields/LATIN_dongle/Kconfig.defconfig
```kconfig
if SHIELD_LATIN_DONGLE

config ZMK_KEYBOARD_NAME
    default "LATIN-Dongle"

# 接收器 = 主机（连接收键盘）
config ZMK_BLE_CENTRAL
    default y

# 完全关闭分体（重要！）
config ZMK_SPLIT
    default n

config BT_MAX_CONN
    default 2

config BT_MAX_PAIRED
    default 2

endif
```
